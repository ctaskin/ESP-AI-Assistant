## main/Kconfig.projbuild
```kconfig
menu "Ceko"
config CEKO_WIFI_SSID
    string "Wi-Fi SSID (2.4 GHz)"
    default ""
config CEKO_WIFI_PASSWORD
    string "Wi-Fi password"
    default ""

choice CEKO_PROVIDER
    prompt "Realtime voice service"
    default CEKO_PROVIDER_OPENAI
    help
      OpenAI is the validated path. Gemini Live adds Google Search on the
      service side, costs less per minute, but its wire protocol has not been
      verified against a live account in this project yet.
config CEKO_PROVIDER_OPENAI
    bool "OpenAI Realtime"
config CEKO_PROVIDER_GEMINI
    bool "Google Gemini Live (experimental)"
endchoice

config CEKO_OPENAI_API_KEY
    string "OpenAI API key (personal prototype only)"
    depends on CEKO_PROVIDER_OPENAI
    default ""
config CEKO_MODEL
    string "OpenAI Realtime model ID"
    depends on CEKO_PROVIDER_OPENAI
    default "gpt-realtime-2.1"
    help
      gpt-realtime-2.1 answers better; gpt-realtime-2.1-mini costs about a
      third per minute of audio.
config CEKO_VOICE
    string "OpenAI voice"
    depends on CEKO_PROVIDER_OPENAI
    default "marin"
config CEKO_REASONING_EFFORT
    string "OpenAI reasoning effort (empty = do not send)"
    depends on CEKO_PROVIDER_OPENAI
    default "low"
    help
      low keeps replies fast. Leave empty for accounts or models that reject
      the field.
config CEKO_TRANSCRIBE_MODEL
    string "OpenAI input transcription model"
    depends on CEKO_PROVIDER_OPENAI
    default "gpt-4o-mini-transcribe"
    help
      Only used when conversation memory is on; it is billed separately.
config CEKO_OPENAI_MCP_URL
    string "Remote MCP server URL for search (empty = no web access)"
    depends on CEKO_PROVIDER_OPENAI && CEKO_WEB_SEARCH
    default ""
config CEKO_OPENAI_MCP_LABEL
    string "Remote MCP server label"
    depends on CEKO_PROVIDER_OPENAI && CEKO_WEB_SEARCH
    default "search"
config CEKO_OPENAI_MCP_TOKEN
    string "Remote MCP authorization value (optional)"
    depends on CEKO_PROVIDER_OPENAI && CEKO_WEB_SEARCH
    default ""
config CEKO_OPENAI_HOSTED_WEB_SEARCH
    bool "Ask for the hosted web_search tool (experimental)"
    depends on CEKO_PROVIDER_OPENAI && CEKO_WEB_SEARCH
    default n
    help
      Hosted web search is not documented as available on the Realtime
      endpoint. Accounts that reject it answer session.update with
      invalid_value, and the session then comes up without any tool.

config CEKO_GEMINI_API_KEY
    string "Google AI Studio API key"
    depends on CEKO_PROVIDER_GEMINI
    default ""
config CEKO_GEMINI_MODEL
    string "Gemini Live model ID"
    depends on CEKO_PROVIDER_GEMINI
    default "gemini-3.1-flash-live-preview"
config CEKO_GEMINI_VOICE
    string "Gemini prebuilt voice"
    depends on CEKO_PROVIDER_GEMINI
    default "Puck"

config CEKO_WEB_SEARCH
    bool "Let the assistant search the web"
    default y
    help
      Gemini uses Google Search on the service side. OpenAI needs a remote MCP
      search server address; without one the assistant has no web access unless
      the experimental hosted tool below is switched on.
config CEKO_MEMORY_TURNS
    int "Conversation turns carried across a reconnect (0 = off)"
    range 0 6
    default 4
    help
      The open session already remembers the conversation. These turns are
      transcripts kept in RAM so context survives a dropped or renewed
      connection. Above 0 the service is asked to transcribe input audio,
      which is billed separately.

config CEKO_WAKE_THRESHOLD
    int "WakeNet detection threshold percent (0 = model default)"
    range 0 99
    default 0
    help
      The wake word itself is chosen under
      "ESP Speech Recognition > Load Multiple Wake Words", not here.

      0 keeps the threshold the model ships with, which is what Espressif
      tuned it to. Set 40-99 only to override it: lower reacts more easily
      but wakes on the wrong sounds more often.
config CEKO_TOUCH_WAKE
    bool "Start listening when the screen is touched"
    default y
    help
      A tap is only accepted while idle; during THINK and SPEAK the recording
      buffer belongs to the network task.
config CEKO_BOOT_BUTTON
    bool "BOOT button (GPIO0) starts listening"
    default y
    help
      A third way in, next to the wake word and the touch panel. It needs
      neither microphone nor panel, so it keeps working while those are being
      brought up.

config CEKO_SILENCE_MS
    int "End utterance after silence (ms)"
    range 400 3000
    default 1000
config CEKO_FOLLOWUP_SECONDS
    int "Keep listening after an answer (seconds, 0 = off)"
    range 0 20
    default 6
    help
      After Ceko answers it stays in listening mode for this long, so a
      conversation can continue without repeating the wake word. Say nothing
      and it returns to idle on its own.

      The session already keeps the conversation, so a follow-up turn costs
      only the new audio. After a failed request the window is not opened.
config CEKO_MAX_RECORD_SECONDS
    int "Maximum utterance seconds"
    range 5 30
    default 20
config CEKO_SPEAKER_VOLUME
    int "Speaker volume percent"
    range 0 90
    default 65
config CEKO_MIC_GAIN
    int "Microphone gain dB"
    range 0 42
    default 24
config CEKO_MIC_RIGHT_SLOT
    bool "Use right I2S microphone slot (normally left)"
    default n
config CEKO_DISPLAY_ROTATE_180
    bool "Rotate display 180 degrees (vendor orientation)"
    default y
config CEKO_FACE_DEMO
    bool "Offline face animation demo (no Wi-Fi / API / microphone)"
    default n
endmenu
```
